#include <dt-bindings/zmk/matrix_transform.h>

/ {
    chosen {
        zmk,kscan = &default_kscan;
    };

    default_kscan: kscan {
        compatible = "zmk,kscan-gpio-direct";
        label = "default_kscan";

        input-gpios
			= <&pro_micro_a 3 (GPIO_ACTIVE_LOW | GPIO_PULL_UP)>
            , <&pro_micro_a 2 (GPIO_ACTIVE_LOW | GPIO_PULL_UP)>
            , <&pro_micro_a 1 (GPIO_ACTIVE_LOW | GPIO_PULL_UP)>
            , <&pro_micro_a 0 (GPIO_ACTIVE_LOW | GPIO_PULL_UP)>
            , <&pro_micro_a 15 (GPIO_ACTIVE_LOW | GPIO_PULL_UP)>
            , <&pro_micro_a 14 (GPIO_ACTIVE_LOW | GPIO_PULL_UP)>
            , <&pro_micro_a 16 (GPIO_ACTIVE_LOW | GPIO_PULL_UP)>
            , <&pro_micro_a 10 (GPIO_ACTIVE_LOW | GPIO_PULL_UP)>
            ;
            
    };

};